## Kconfig.projbuild
```kconfig
menu "JBLib Net Utilities"

	menu "DNS Server"
	
		config JBLIB_DNS_SERVER_CONSOLE_ENABLE
			bool "Enable console"
			default y
		
		config JBLIB_DNS_SERVER_RESPONSE_TO_ALL_REQUESTS
			bool "Send response to requests for any address"
			default n
			
		config JBLIB_DNS_SERVER_HOST_NAME_MAX_SIZE
			int "Max size of the host name"
			range 64 1024
			default 128
			
		config JBLIB_DNS_SERVER_THREAD_STACK_SIZE
			int "Thread stack size"
			range 512 8192
			default 3072

		config JBLIB_DNS_SERVER_THREAD_PRIORITY
			int "Thread priority"
			range 1 32
			default 1
			
		config JBLIB_DNS_SERVER_RECIEVE_BUFFER_SIZE
			int "Recieve request buffer size"
			range 256 1536
			default 1536
			
		config JBLIB_DNS_SERVER_PORT
			int "Port"
			range 0 65535
			default 53

	endmenu  #DNS Server		

	menu "UDP Channel"
	
		config JBLIB_UDP_CHANNEL_CONSOLE_ENABLE
			bool "Enable console"
			default n
			
		config JBLIB_UDP_CHANNEL_THREAD_STACK_SIZE
			int "Thread stack size"
			range 512 8192
			default 2048

		config JBLIB_UDP_CHANNEL_THREAD_PRIORITY
			int "Thread priority"
			range 1 32
			default 1

		config JBLIB_UDP_CHANNEL_RX_BUFFER_SIZE
			int "Temp rx buffer size"
			range 128 4096 
			default 2048

	endmenu  #UDP Channel	

	
endmenu  #JBLib Net Utilities
```
